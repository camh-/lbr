## Config.in
```kconfig
source "$BR2_EXTERNAL_clusterpi_PATH/package/nomad/Config.in"
source "$BR2_EXTERNAL_clusterpi_PATH/package/sunxi-fel/Config.in.host"
```

## board/common/linux/4.11/defconfig
```kconfig
CONFIG_SYSVIPC=y
CONFIG_POSIX_MQUEUE=y
CONFIG_NO_HZ=y
CONFIG_HIGH_RES_TIMERS=y
CONFIG_IKCONFIG=y
CONFIG_IKCONFIG_PROC=y
CONFIG_CGROUPS=y
CONFIG_CGROUP_DEBUG=y
CONFIG_CGROUP_FREEZER=y
CONFIG_CGROUP_PIDS=y
CONFIG_CGROUP_DEVICE=y
CONFIG_CPUSETS=y
CONFIG_CGROUP_CPUACCT=y
CONFIG_MEMCG=y
CONFIG_CGROUP_SCHED=y
CONFIG_CFS_BANDWIDTH=y
CONFIG_RT_GROUP_SCHED=y
CONFIG_BLK_CGROUP=y
CONFIG_NAMESPACES=y
CONFIG_USER_NS=y
CONFIG_EMBEDDED=y
CONFIG_PERF_EVENTS=y
CONFIG_MODULES=y
CONFIG_MODULE_UNLOAD=y
CONFIG_BLK_DEV_THROTTLING=y
CONFIG_BLK_WBT=y
CONFIG_BLK_WBT_SQ=y
CONFIG_CFQ_GROUP_IOSCHED=y
CONFIG_HOTPLUG_CPU=y
CONFIG_CPU_FREQ=y
CONFIG_CPU_FREQ_GOV_POWERSAVE=y
CONFIG_CPU_FREQ_GOV_USERSPACE=y
CONFIG_CPU_FREQ_GOV_ONDEMAND=y
CONFIG_CPU_FREQ_GOV_SCHEDUTIL=y
CONFIG_CPUFREQ_DT=y
# CONFIG_SUSPEND is not set
CONFIG_PM=y
CONFIG_NET=y
CONFIG_PACKET=y
CONFIG_PACKET_DIAG=y
CONFIG_UNIX=y
CONFIG_UNIX_DIAG=y
CONFIG_INET=y
CONFIG_IP_MULTICAST=y
CONFIG_IP_PNP=y
CONFIG_IP_PNP_DHCP=y
CONFIG_NET_IPIP=y
# CONFIG_INET_XFRM_MODE_TRANSPORT is not set
# CONFIG_INET_XFRM_MODE_TUNNEL is not set
# CONFIG_INET_XFRM_MODE_BEET is not set
# CONFIG_INET_DIAG is not set
# CONFIG_IPV6 is not set
CONFIG_VLAN_8021Q=y
CONFIG_CGROUP_NET_PRIO=y
CONFIG_CFG80211=y
CONFIG_MAC80211=y
CONFIG_NET_9P=y
CONFIG_DEVTMPFS=y
CONFIG_DEVTMPFS_MOUNT=y
CONFIG_NETDEVICES=y
CONFIG_TUN=y
CONFIG_VETH=y
CONFIG_USB_USBNET=y
CONFIG_USB_NET_MCS7830=m
CONFIG_INPUT_EVDEV=y
# CONFIG_INPUT_KEYBOARD is not set
# CONFIG_INPUT_MOUSE is not set
# CONFIG_VT is not set
# CONFIG_LEGACY_PTYS is not set
# CONFIG_HW_RANDOM is not set
CONFIG_USB_HIDDEV=y
CONFIG_USB=y
CONFIG_USB_ANNOUNCE_NEW_DEVICES=y
CONFIG_LEDS_TRIGGERS=y
CONFIG_LEDS_TRIGGER_HEARTBEAT=y
CONFIG_LEDS_TRIGGER_DEFAULT_ON=y
CONFIG_EXT4_FS=y
CONFIG_EXT4_FS_POSIX_ACL=y
CONFIG_FANOTIFY=y
CONFIG_FUSE_FS=y
CONFIG_OVERLAY_FS=y
CONFIG_OVERLAY_FS_REDIRECT_DIR=y
CONFIG_VFAT_FS=y
CONFIG_TMPFS=y
CONFIG_TMPFS_POSIX_ACL=y
CONFIG_NFS_FS=y
CONFIG_NFS_V3_ACL=y
CONFIG_NFS_V4=y
CONFIG_NFS_V4_1=y
CONFIG_NFS_V4_2=y
CONFIG_ROOT_NFS=y
CONFIG_9P_FS=y
CONFIG_9P_FS_POSIX_ACL=y
CONFIG_NLS_CODEPAGE_437=y
CONFIG_NLS_ISO8859_1=y
CONFIG_PRINTK_TIME=y
CONFIG_DEBUG_FS=y
# CONFIG_SCHED_DEBUG is not set
# CONFIG_FTRACE is not set
# CONFIG_CRYPTO_ECHAINIV is not set
```

## board/sunxi/linux/4.5/defconfig
```kconfig
CONFIG_BLK_DEV_INITRD=y
CONFIG_BLK_CMDLINE_PARSER=y
CONFIG_ARCH_SUNXI=y
CONFIG_SMP=y
CONFIG_AEABI=y
CONFIG_HIGHMEM=y
CONFIG_VFP=y
CONFIG_NEON=y
CONFIG_BLK_DEV_SD=y
CONFIG_ATA=y
CONFIG_AHCI_SUNXI=y
# CONFIG_ATA_SFF is not set
CONFIG_SUN4I_EMAC=y
CONFIG_STMMAC_ETH=y
CONFIG_SERIAL_8250=y
CONFIG_SERIAL_8250_CONSOLE=y
CONFIG_SERIAL_8250_NR_UARTS=8
CONFIG_SERIAL_8250_RUNTIME_UARTS=8
CONFIG_SERIAL_8250_DW=y
CONFIG_SERIAL_OF_PLATFORM=y
CONFIG_I2C=y
CONFIG_I2C_CHARDEV=y
CONFIG_I2C_MV64XXX=y
CONFIG_I2C_SUN6I_P2WI=y
CONFIG_SPI=y
CONFIG_SPI_SUN4I=y
CONFIG_SPI_SUN6I=y
CONFIG_GPIO_SYSFS=y
CONFIG_POWER_SUPPLY=y
CONFIG_AXP20X_POWER=y
CONFIG_THERMAL=y
CONFIG_CPU_THERMAL=y
CONFIG_WATCHDOG=y
CONFIG_SUNXI_WATCHDOG=y
CONFIG_MFD_AXP20X=y
CONFIG_REGULATOR=y
CONFIG_REGULATOR_FIXED_VOLTAGE=y
CONFIG_REGULATOR_AXP20X=y
CONFIG_REGULATOR_GPIO=y
CONFIG_USB_EHCI_HCD=y
CONFIG_USB_EHCI_HCD_PLATFORM=y
CONFIG_USB_OHCI_HCD=y
CONFIG_USB_OHCI_HCD_PLATFORM=y
CONFIG_USB_STORAGE=y
CONFIG_USB_UAS=y
CONFIG_MMC=y
CONFIG_MMC_SUNXI=y
CONFIG_NEW_LEDS=y
CONFIG_LEDS_CLASS=y
CONFIG_LEDS_GPIO=y
CONFIG_RTC_CLASS=y
CONFIG_RTC_DRV_SUN6I=y
CONFIG_RTC_DRV_SUNXI=y
CONFIG_DMADEVICES=y
CONFIG_DMA_SUN6I=y
# CONFIG_IOMMU_SUPPORT is not set
CONFIG_EXTCON=y
CONFIG_PWM=y
CONFIG_PWM_SUN4I=y
CONFIG_PHY_SUN4I_USB=y
CONFIG_PHY_SUN9I_USB=y
CONFIG_NVMEM=y
CONFIG_NVMEM_SUNXI_SID=y
CONFIG_CRYPTO_DEV_SUN4I_SS=y
```

## configs/arm-a7-gnueabihf_toolchain_client_defconfig
```kconfig
BR2_arm=y
BR2_cortex_a7=y
BR2_ARM_FPU_NEON_VFPV4=y
BR2_DL_DIR="/data/download/buildroot"
BR2_TOOLCHAIN_EXTERNAL=y
BR2_TOOLCHAIN_EXTERNAL_CUSTOM=y
BR2_TOOLCHAIN_EXTERNAL_PATH="/opt/brtc/arm-a7-gnueabihf/usr"
BR2_TOOLCHAIN_EXTERNAL_GCC_4_9=y
BR2_TOOLCHAIN_EXTERNAL_HEADERS_4_4=y
BR2_TOOLCHAIN_EXTERNAL_CUSTOM_GLIBC=y
BR2_TOOLCHAIN_EXTERNAL_CXX=y
BR2_BUILD_OVERLAY_ONLY=y
BR2_TARGET_GENERIC_HOSTNAME=""
BR2_TARGET_GENERIC_ISSUE=""
BR2_TARGET_GENERIC_PASSWD_SHA512=y
BR2_INIT_NONE=y
BR2_ROOTFS_DEVICE_TABLE=""
# BR2_PACKAGE_BUSYBOX is not set
BR2_TARGET_ROOTFS_TAR_BZIP2=y
```

## configs/arm-a7-gnueabihf_toolchain_defconfig
```kconfig
BR2_arm=y
BR2_cortex_a7=y
BR2_ARM_EABIHF=y
BR2_ARM_FPU_NEON_VFPV4=y
BR2_DL_DIR="/data/download/buildroot"
BR2_HOST_DIR="/opt/brtc/arm-a7-gnueabihf"
BR2_TOOLCHAIN_BUILDROOT_GLIBC=y
BR2_TOOLCHAIN_BUILDROOT_CXX=y
BR2_GCC_ENABLE_LTO=y
BR2_GCC_ENABLE_OPENMP=y
BR2_GCC_ENABLE_GRAPHITE=y
BR2_PACKAGE_HOST_GDB=y
BR2_PACKAGE_HOST_GDB_TUI=y
BR2_PACKAGE_HOST_GDB_PYTHON=y
BR2_GDB_VERSION_7_9=y
BR2_BUILD_OVERLAY_ONLY=y
BR2_TARGET_GENERIC_HOSTNAME=""
BR2_TARGET_GENERIC_ISSUE=""
BR2_TARGET_GENERIC_PASSWD_SHA512=y
BR2_INIT_NONE=y
BR2_ROOTFS_DEVICE_TABLE=""
# BR2_PACKAGE_BUSYBOX is not set
BR2_TARGET_ROOTFS_TAR_BZIP2=y
```

## core/Config.in
```kconfig
config LBR_CONFIG_FRAGMENTS
	string "Fragments to add to this config"
	help
	  Fragments to combine to create the defconfig.

	  The defconfig for the build can be build from fragments so you
	  do not need to specify the same configuration for multiple
	  layers. Each fragment is applied in order with this config
	  being applied last. The latest value for a setting overrides
	  any previous values.

	  When the defconfig for this layer is saved, the fragments are
	  removed so as to leave a minimal defconfig that contains only
	  the configuration items specific to this layer.

	  Config fragments are found by searching in the board's config
	  directory, the config directory of each element in the parent
	  chain for the board, the project's config directory and the
	  core config directory, in that order.

config LBR_BUILD_OVERLAY
       bool "Build an overlay-only image"
       default n
       help
         Build an image to use as an overlay for another build.

         Buildroot supports customizing the target root filesystem
         with overlays, which are parallel directory trees overlaid
         over the root filesystem that buildroot builds.

         If you select yes here, buildroot will build such an image
         overlay without the skeleton parts of the image so that it
         can be overlayed over a standard buildroot rootfs image.

	 This option is only applied if the LBR_CORE post-build script
	 is executed, by adding $(BR2_EXTERNAL_LBR_CORE_PATH)/post-build.sh
	 to BR2_ROOTFS_POST_BUILD_SCRIPT.

config LBR_OVERLAY_IMAGES
	string "Layer image overlays to add to this layer"
	help
	  Overlay images to incorporate into this build.

	  Image names should be specified as <layer> or <board>/<layer>.
	  Image names without a <board> refer to the current board.

config LBR_POST_IMAGE_SCRIPTS
	string "Post-image scripts to run after lbr post-image"
	help
	  Space-separated list of scripts to run after copying images.

	  lbr copies the layer images into the board images directory as
	  part of the post-build. The script listed here will be run
	  after those images have been copied. If a script is not an
	  absolute path, it is located by searching the board hierarchy.

	  The scripts will be run with the board image directory as the
	  current directory, which will also be passed as the first
	  argument.

	  If you want to run scripts before the lbr post-image processing,
	  add the scripts to the buildroot BR2_ROOTFS_POST_IMAGE_SCRIPT
	  variable.

config LBR_RENAME_LAYER_IMAGE
	bool "Add layer name to build images"
	default y
	help
	  Name images with the layer when copying to the board image dir.

	  When copying images to the board image directory, put the layer
	  name in the filename for rootfs images. e.g. rootfs.tar.gz becomes
	  rootfs-layer.tar.gz.

	  This is the default and should only be turned off for one of the
	  layers, otherwise the filenames will conflict. Turning off rename
	  allows one layer (usually one that includes the others) to have
	  a well-known name (rootfs.tar.gz)/
```

## package/nomad/Config.in
```kconfig
config BR2_PACKAGE_NOMAD
	bool "Nomad cluster scheduler"
	depends on BR2_PACKAGE_HOST_GO_ARCH_SUPPORTS
	depends on BR2_PACKAGE_HOST_GO_CGO_LINKING_SUPPORTS
	depends on BR2_TOOLCHAIN_HAS_THREADS
	help
	  Nomad cluster scheduler.

	  https://www.nomadproject.io
```

## package/sunxi-fel/Config.in.host
```kconfig
config BR2_PACKAGE_HOST_SUNXI_FEL
	bool "host sunxi-fel"
	depends on BR2_arm
	help
	  Tools for Allwinner-based devices. This builds sunxi-fel
	  to interface via USB with the FEL handler built into the
	  Allwinner CPUs.

	  http://linux-sunxi.org/Sunxi-tools
```
